## buildroot/configs/pspi6_cm4_defconfig
```kconfig
# Target Architecture
BR2_aarch64=y
BR2_cortex_a7=y

# Toolchain
BR2_TOOLCHAIN_BUILDROOT_GLIBC=y

# Build Options
BR2_GLOBAL_PATCH_DIR="board/pspi6-cm4/patches"

# Filesystem
BR2_TARGET_ROOTFS_EXT2=y
BR2_TARGET_ROOTFS_EXT2_4=y
BR2_TARGET_ROOTFS_EXT2_SIZE="256M"
BR2_TARGET_GENERIC_GETTY=y
BR2_TARGET_GENERIC_GETTY_PORT="tty1"
# BR2_TARGET_ROOTFS_TAR is not set

# Linux Kernel
BR2_LINUX_KERNEL=y
BR2_LINUX_KERNEL_CUSTOM_TARBALL=y
BR2_LINUX_KERNEL_CUSTOM_TARBALL_LOCATION="$(call github,raspberrypi,linux,cd231d4775b14f228606c09f219b48308f6ab3aa)/linux-cd231d4775b14f228606c09f219b48308f6ab3aa.tar.gz"
BR2_LINUX_KERNEL_DEFCONFIG="bcm2711"
BR2_LINUX_KERNEL_DTS_SUPPORT=y
BR2_LINUX_KERNEL_INTREE_DTS_NAME="broadcom/bcm2711-rpi-4-b broadcom/bcm2711-rpi-400 broadcom/bcm2711-rpi-cm4 broadcom/bcm2711-rpi-cm4s"
BR2_LINUX_KERNEL_NEEDS_HOST_OPENSSL=y

# Packages
BR2_PACKAGE_HOST_LINUX_HEADERS_CUSTOM_6_12=y
BR2_PACKAGE_HOST_GENIMAGE=y
BR2_PACKAGE_HOST_DOSFSTOOLS=y
BR2_PACKAGE_HOST_KMOD_XZ=y
BR2_PACKAGE_HOST_MTOOLS=y

# Raspberry Pi Firmware
BR2_PACKAGE_RPI_FIRMWARE=y
BR2_PACKAGE_RPI_FIRMWARE_BOOTCODE_BIN=y
BR2_PACKAGE_RPI_FIRMWARE_VARIANT_PI=y
BR2_PACKAGE_RPI_FIRMWARE_CONFIG_FILE="board/pspi6-cm4/config-cm4.txt"

# Post-build scripts
BR2_ROOTFS_POST_BUILD_SCRIPT="board/pspi6-cm4/post-build.sh"
BR2_ROOTFS_POST_IMAGE_SCRIPT="board/pspi6-cm4/post-image.sh"
BR2_EXTERNAL_BOARD_PATH="board/pspi6-cm4"
```

## buildroot/package/pspi6/Config.in
```kconfig
config BR2_PACKAGE_PSPI6
	bool "PSPi6 support"
	help
	  Install PSPi6 boot config, kernel and overlays
```
